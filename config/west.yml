## config/west.yml
```yaml
manifest:
  remotes:
    - name: zmkfirmware
      url-base: https://github.com/zmkfirmware
    # Additional modules containing boards/shields/custom code can be listed here as well
    # See https://docs.zephyrproject.org/3.2.0/develop/west/manifest.html#projects
    # nice_view_gem
    - name: m165437
      url-base: https://github.com/M165437
    # nice_oled
    - name: mctechnology17
      url-base: https://github.com/mctechnology17
  projects:
    - name: zmk
      remote: zmkfirmware
      revision: main
      import: app/west.yml
    # nice_view_gem
    - name: nice-view-gem
      remote: m165437
      revision: main
    # nice_oled
    - name: zmk-nice-oled
      remote: mctechnology17
      revision: main
  self:
    path: config
```
